## meta-mitaccomputing/mainboard/meta-b8261/conf/layer.conf
```bitbake
# We have a conf and classes directory, add to BBPATH
BBPATH .= ":${LAYERDIR}"

# We have recipes-* directories, add to BBFILES
BBFILES += "${LAYERDIR}/recipes-*/*/*.bb \
            ${LAYERDIR}/recipes-*/*/*.bbappend"

BBFILE_COLLECTIONS += "b8261-layer"
BBFILE_PATTERN_b8261-layer = "^${LAYERDIR}/"
BBFILE_PRIORITY_b8261-layer = "5"
LAYERSERIES_COMPAT_b8261-layer = "nanbield scarthgap"
```
